## drivers/cpufreq/hisi/Kconfig.arm
```kconfig
config ARCH_HISI_MAXFREQ
	bool "Hisilicon platform cpu max freq recognition"
	depends on PM_OPP
	default n
	help
	  Hisilicon platform cpu max freq recognition.

config HISI_ENABLE_GET_VAL
	bool "Hisilicon get cpufreq param"
	default n
	help
	  Hisilicon get cpufreq param.

config HISI_ENABLE_HPM_DATA_COLLECT
	bool "Hisilicon get hpm volt param"
	depends on HISI_ENABLE_GET_VAL
	default n
	help
	  Hisilicon get avs hpm volt param.

config HISI_BIG_MAXFREQ_HOTPLUG
	tristate "Specific flow for Hisilicon Platform CPUfreq driver"
	depends on ARM_BIG_LITTLE_CPUFREQ && HOTPLUG_CPU
	help
	  This add Hotplug Flow in CPUfreq for Hisilicon Big-little Platform with boost freq.

config HISI_CPUFREQ_DT
	bool "Hisilicon cpufreq-dt enable"
	depends on CPUFREQ_DT
	default n
	help
	  Hisilicon cpufreq-dt enable.

config HISI_HW_VOTE_CPU_FREQ
	bool "Hisilicon cpufreq-hw_vote enable"
	depends on HISI_CPUFREQ_DT
	default n
	help
	  Hisilicon cpufreq-hw_vote enable.

config HISI_CPUDDR_FREQ_LINK
	bool "Hisilicon cpu ddr freq link enable"
	depends on CPUFREQ_DT
	default n
	help
	  Hisilicon cpu ddr freq link enable.

config CLUSTER_PLUG
	bool "Enable cluster-plug cpu hotplug driver (mod version)"
	default n
	help
	  CPU hotplug driver designed for ARM big.LITTLE systems where
	  both the big and little CPUs are of the same type. On these
	  systems, it preferable to normall use the big cluster, and
	  only activate the little cluster for highly parallel loads.
	  This hotplug implementation always keeps the big cluster
	  online, and only activates the little cluster for heavy
	  parallel loads.
	  The mod version adds display on off notification usage support
	  to go to a low power mode (only little clusters enabled)
	  while the screen is suspended.

config OVERCLOCK_AS_KIRIN_655
	bool "Enable overclock for Kirin 650 to 655 max frequency
	depends on ARCH_HISI_MAXFREQ
	default n
	help
	  Enables overclock by setting the target_cpu to Kirin 655 which
	  enables 2362 MHz CPU frequency
```
